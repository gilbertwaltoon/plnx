## cora7s-plnx/project-spec/configs/rootfsconfigs/Kconfig.user
```kconfig
menu "user packages " 
config busyboxwebpage  
	 bool "busyboxwebpage"
	 help
	
config civetweb  
	 bool "civetweb"
	 help
	
config gpio-demo  
	 bool "gpio-demo"
	 help
	
config nano  
	 bool "nano"
	 help
	
config peekpoke  
	 bool "peekpoke"
	 help
	
endmenu
```
